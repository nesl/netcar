## gumstix/buildroot/package/ipkg/Config.in
```kconfig
config BR2_PACKAGE_IPKG
        bool "ipkg"
        default n
        help
	  ipkg

	  http://handhelds.org/
```

## gumstix/buildroot/toolchain/ipkg-utils/Config.in
```kconfig
config BR2_PACKAGE_IPKG_UTILS
	bool "Install ipkg-utils for the target system"
	default n
	help
	  ipkg utility.
```
